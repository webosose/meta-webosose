## meta-webos/conf/distro/webos.conf
```bitbake
# Copyright (c) 2012-2025 LG Electronics, Inc.

DISTRO = "webos"
DISTRO_NAME = "webOS OSE"

# Software Version : A.B.x-C
# A: Major Version
# B: Minor Version
# x: build type
#    g - github

WEBOS_DISTRO_VERSION_MAJOR = "2"
WEBOS_DISTRO_VERSION_MINOR = "27.0"
WEBOS_DISTRO_VERSION_TYPE = "g"

DISTRO_VERSION = "${WEBOS_DISTRO_VERSION_MAJOR}.${WEBOS_DISTRO_VERSION_MINOR}.${WEBOS_DISTRO_VERSION_TYPE}"

require conf/distro/include/profile/webos-${WEBOS_TARGET_DISTRO_VARIANT}.inc

# Each DISTRO needs to allow commercial license explicitly without legal issue.
LICENSE_FLAGS_ACCEPTED:append = " \
    commercial_ffmpeg \
    commercial_gstreamer1.0-libav \
    commercial_gstreamer1.0-omx \
    commercial_gstreamer1.0-plugins-ugly \
    commercial_lame \
    commercial_libav \
    commercial_libomxil \
    commercial_mpeg2dec \
    commercial_mpg123 \
    commercial_x264 \
    synaptics-killswitch \
"
```

## meta-webos/conf/layer.conf
```bitbake
# Copyright (c) 2012-2024 LG Electronics, Inc.

BBPATH ?= ""
# We have a conf and classes directory, add to BBPATH
BBPATH .= ":${LAYERDIR}"
# We have recipe directories, add to BBFILES
BBFILES += "${LAYERDIR}/recipes-*/*/*.bb ${LAYERDIR}/recipes-*/*/*.bbappend"

# Exclude unused recipies from meta-security, use only smack
BBMASK:append = " meta-security\/(?!.*\/smack\/).*"
# Disable the check added in: https://git.yoctoproject.org/cgit/cgit.cgi/meta-security/commit/?id=c1235f6affb5c38e64b3a04533b8388969b194b2
SKIP_META_SECURITY_SANITY_CHECK = "1"

BBFILE_COLLECTIONS += "meta-webos"
BBFILE_PATTERN_meta-webos := "^${LAYERDIR}/"
BBFILE_PRIORITY_meta-webos = "40"

LAYERSERIES_COMPAT_meta-webos = "kirkstone"

LAYERDEPENDS_meta-webos = " \
    core \
    openembedded-layer \
    qt6-layer \
    filesystems-layer \
    networking-layer \
    multimedia-layer \
    meta-python \
    meta-webos-backports-4.1 \
    meta-webos-backports-4.2 \
    meta-webos-backports-4.3 \
    meta-webos-backports-5.0 \
    security \
"

# Remove openembedded-layer perl-layer networking-layer meta-python
# dependencies from meta-security layer
# OVERRIDE for LAYERDEPENDS_security set in the meta-security layer
LAYERDEPENDS_security = "core"

BBFILES_DYNAMIC += " \
    clang-layer:${LAYERDIR}/dynamic-layers/clang-layer/*/*/*.bb \
    clang-layer:${LAYERDIR}/dynamic-layers/clang-layer/*/*/*.bbappend \
"

# Set these variables to build webos outside of build-webos (for OSE only).
# https://github.com/webosose/meta-webosose/issues/28
META_WEBOS_LAYER ??= "${LAYERDIR}"
META_OE_LAYER ??= "${@'${BBFILE_PATTERN_openembedded-layer}'[1:-1]}"

# Prepend scripts to WEBOS_EXTRA_PATH
WEBOS_EXTRA_PATH .= "${@'${BBFILE_PATTERN_meta-webos}'[1:] + 'scripts:'}"

# Set path to qemu image tests included in this layer
QEMUIMAGETESTS := "${COREBASE}/scripts/qemuimage-tests"

# Add extra license path
LICENSE_PATH += "${LAYERDIR}/licenses"

SIGGEN_EXCLUDERECIPES_ABISAFE += " \
    webos-initscripts \
    luna-prefs-data \
    upstart-getty \
    settingsservice-conf \
"

# TODO: introduced long time ago, double check if still needed
# http://gpro.lge.com/c/webos-pro/meta-lg-webos/+/128601/ glibc-mtrace, glibc-scripts, resolvconf: Exclude dependency on perl and busybox
SIGGEN_EXCLUDE_SAFE_RECIPE_DEPS += " \
    glibc-mtrace->perl \
    glibc-scripts->busybox \
    resolvconf->busybox \
"

# This is a bit weird
# gcc-cross-${TARGET_ARCH}->linux-libc-headers
# was already added in 2014 with:
# https://git.openembedded.org/openembedded-core/commit/?id=97df4e8e61a
# but with multilib this doesn't work and it's not about missing ${MLPREFIX} or lib32- prefix
# it's the ${TARGET_ARCH} which is possibly expanded too late even when in bitbake -e it looks right
SIGGEN_EXCLUDE_SAFE_RECIPE_DEPS += " \
    gcc-cross-arm->linux-libc-headers \
"

# lsb-release is rebuilt every time due to BUILD_ID changing
# in every jenkins job due to BUILD_NUMBER or in local builds
# whenever DATETIME changes
SIGGEN_EXCLUDE_SAFE_RECIPE_DEPS += " \
    bootchart2->lsb-release \
    keyutils->lsb-release \
    nyx-modules->lsb-release \
    packagegroup-core-boot->lsb-release \
"
```

## meta-webos/conf/machine/include/webos-target-machine-alias.inc
```bitbake
# Copyright (c) 2015-2023 LG Electronics, Inc.
#
# webos-target-machine-alias.inc
#
# This file is to be require-d by all MACHINE.conf-s that specify a machine
# alias. It is expected that it will set WEBOS_TARGET_MACHINE_ALIAS before
# the require.
#

MACHINEOVERRIDES .= "${@ \
    '' \
    if bb.data.inherits_class('webos_machine_actual_dep', d) else \
    ':${WEBOS_TARGET_MACHINE_ALIAS}' \
}"

WEBOS_TARGET_MACHINE_ACTUAL = "${@ \
    '${MACHINE}' \
    if bb.data.inherits_class('webos_machine_actual_dep', d) else \
    '${WEBOS_TARGET_MACHINE_ALIAS}' \
}"
WEBOS_TARGET_MACHINE_ACTUAL[vardepvalue] = "${WEBOS_TARGET_MACHINE_ACTUAL}"

WEBOS_MACHINE = "${WEBOS_TARGET_MACHINE_ACTUAL}"
WEBOS_SIGNTOOL_MACHINE = "${WEBOS_TARGET_MACHINE_ACTUAL}"
PARTINFO_MACHINE = "${WEBOS_TARGET_MACHINE_ACTUAL}"
DEVICE_TABLE_MACHINE = "${WEBOS_TARGET_MACHINE_ACTUAL}"
WEBOS_QMAKE_MACHINE_ACTUAL = "${WEBOS_TARGET_MACHINE_ACTUAL}"
EXTRA_OECMAKE_MACHINE_ACTUAL = "${WEBOS_TARGET_MACHINE_ACTUAL}"
```

## meta-webos/wic/webos-qemux86-directdisk.wks
```
# this file is combination of:
# oe-core/scripts/lib/wic/canned-wks/common.wks.inc
#     + oe-core/scripts/lib/wic/canned-wks/qemux86-directdisk.wks
# '--ondisk sda' replaced with '--ondisk hda'

part /boot --source bootimg-pcbios --ondisk hda --label boot --active --align 1024
part / --source rootfs --use-uuid --fstype=ext4 --label platform --align 1024
bootloader  --timeout=0  --append="vga=0 rw oprofile.timer=1 rootfstype=ext4 "
```
