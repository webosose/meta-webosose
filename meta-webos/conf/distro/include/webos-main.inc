## meta-webos/conf/distro/include/webos-main.inc
```bitbake
# Copyright (c) 2023 LG Electronics, Inc.

require conf/distro/include/webos.inc
require conf/distro/include/webos-features-main.inc

WEBOS_DISTRO_NAME_SUFFIX = " Main"
```

## meta-webos/conf/distro/include/webos-normal.inc
```bitbake
# Copyright (c) 2023 LG Electronics, Inc.

require conf/distro/include/webos.inc
require conf/distro/include/webos-features-normal.inc

WEBOS_DISTRO_NAME_SUFFIX = ""
```

## meta-webos/conf/distro/include/webos-preferred-providers.inc
```bitbake
# Copyright (c) 2012-2022 LG Electronics, Inc.

# Place distro-wide PREFERRED_PROVIDER settings here. Place MACHINE-specific
# settings (always with a _<MACHINE> override) in <MACHINE>.conf with a default
# for the emulator set here (with regular assignment, so that it can be
# overridden by higher layers whose distro .inc files are always included after
# this one) and "MACHINE" appended to their [vardeps] flags.

PREFERRED_PROVIDER_virtual/webruntime = "webruntime"
VIRTUAL-RUNTIME_webruntime = "webruntime"

WEBOS_PREFERRED_PROVIDER_FOR_BASH = "busybox"
PREFERRED_PROVIDER_bash = "${@oe.utils.conditional('WEBOS_PREFERRED_PROVIDER_FOR_BASH', 'busybox', 'busybox', 'bash', d)}"
VIRTUAL-RUNTIME_bash = "${@oe.utils.conditional('WEBOS_PREFERRED_PROVIDER_FOR_BASH', 'busybox', 'busybox', 'bash', d)}"

# Use the busybox Tar instead of GNU Tar
WEBOS_PREFERRED_PROVIDER_FOR_TAR = "busybox"
PREFERRED_PROVIDER_tar = "${@oe.utils.conditional('WEBOS_PREFERRED_PROVIDER_FOR_TAR', 'busybox', 'busybox', 'tar', d)}"
VIRTUAL-RUNTIME_tar = "${@oe.utils.conditional('WEBOS_PREFERRED_PROVIDER_FOR_TAR', 'busybox', 'busybox', 'tar', d)}"

# Prefer libjpeg-turbo from meta-oe as it provides SIMD optimizations
PREFERRED_PROVIDER_jpeg = "libjpeg-turbo"
PREFERRED_PROVIDER_jpeg-native = "libjpeg-turbo-native"

PREFERRED_PROVIDER_stat = "busybox"
VIRTUAL-RUNTIME_stat = "busybox"
VIRTUAL-RUNTIME_webos-ime = "imemanager"

VIRTUAL-RUNTIME_bluetooth_service = "com.webos.service.bluetooth2"

# Options are: bluez4, bluez5. This will only be used if "bluetooth" appears in
# DISTRO_FEATURES.
VIRTUAL-RUNTIME_bluetooth_stack = "bluez5"
BLUETOOTH_SIL_NAME = "bluez5"

BLUEZ = "${VIRTUAL-RUNTIME_bluetooth_stack}"
BLUEZ:class-native = "bluez5"
BLUEZ:class-nativesdk = "bluez5"

# Just for documentation; these values are the defaults set in the recipes that
# use them.
VIRTUAL-RUNTIME_cpushareholder = "cpushareholder-stub"

# Use Enactbrowser by default, except for armv45
VIRTUAL-RUNTIME_com.webos.app.browser ?= "com.webos.app.enactbrowser"
VIRTUAL-RUNTIME_com.webos.app.browser:armv4 = ""
VIRTUAL-RUNTIME_com.webos.app.browser:armv5 = ""

VIRTUAL-RUNTIME_webappmanager = "wam"
VIRTUAL-RUNTIME_webappmanager:armv4 = ""
VIRTUAL-RUNTIME_webappmanager:armv5 = ""

VIRTUAL-RUNTIME_initscripts = "webos-initscripts"
PREFERRED_RPROVIDER_initd-functions = "webos-initscripts"

PREFERRED_RPROVIDER_ssh = "dropbear"

# Options are: sysvinit, upstart, systemd
VIRTUAL-RUNTIME_init_manager = "systemd"

# With upstart we don't need update-rc.d, as bonus fixes following avahi issue for us:
# http://lists.openembedded.org/pipermail/openembedded-core/2013-November/086901.html
BAD_RECOMMENDATIONS += "update-rc.d"
UPDATERCD:class-target = ""

# Don't install big /boot/vmlinux* file by default in qemux86 images (included in oprofile's RRECOMMENDS)
# Use --no-vmlinux option to opcontrol or install it manually if you need to see samples from kernel
BAD_RECOMMENDATIONS:append:qemux86 = " kernel-vmlinux"

PREFERRED_PROVIDER_virtual/docker = "docker-moby"

# Define which modules should be built by nyx-modules by default.
#
# "webOS OSE" (defined by the meta-webos layer) builds only for the qemux86 emulator, therefore
# include all the emulator modules.
#
NYX_MODULES_REQUIRED ??= "\
    NYXMOD_OW_OSINFO;\
    NYXMOD_OW_DEVICEINFO;\
    NYXMOD_OW_SYSTEM;\
    NYXMOD_OW_DISPLAY;\
    NYXMOD_QEMU_BATTERY;\
    NYXMOD_OW_SECURITY;\
    NYXMOD_OW_SECURITY2;\
    NYXMOD_QEMU_CHARGER;\
    NYXMOD_QEMU_KEYS;\
    NYXMOD_QEMU_TOUCHPANEL;\
"

VIRTUAL-RUNTIME_nyx_modules_providers ??= "\
    nyx-modules \
    nyx-modules-qemux86 \
"

# Make wam preferred provider for webappmanager-webos
PREFERRED_PROVIDER_webappmanager-webos ?= "wam"

VIRTUAL-RUNTIME_ntp = "ntp sntp"

# Options: luna-surface-manager, auto-luna-surface-manager
VIRTUAL-RUNTIME_surface-manager = "luna-surfacemanager-base"
VIRTUAL-RUNTIME_surface-manager-conf = "auto-luna-surface-manager"
VIRTUAL-RUNTIME_surface-manager-extension = "auto-luna-surface-manager"
VIRTUAL-RUNTIME_surface-manager-tests = "luna-surfacemanager-base-tests"

# Options: com.webos.service.pdm, physical-device-manager, physical-device-manager2
VIRTUAL-RUNTIME_pdm = "com.webos.service.pdm"
```

## meta-webos/conf/distro/include/webos-preferred-versions.inc
```bitbake
# Copyright (c) 2012-2025 LG Electronics, Inc.

# Set default chromium version for webruntime and mksnapshot
PREFERRED_VERSION_webruntime = "120.%"
PREFERRED_VERSION_webruntime-clang = "${PREFERRED_VERSION_webruntime}"
PREFERRED_VERSION_mksnapshot-cross-${TARGET_ARCH} = "${PREFERRED_VERSION_webruntime}"

# Prefer gstreamer version 1.20.% from oe-core for webos
GSTREAMER_VERSION = "1.22.%"

PREFERRED_VERSION_gstreamer1.0              = "${GSTREAMER_VERSION}"
PREFERRED_VERSION_gstreamer1.0-plugins-bad  = "${GSTREAMER_VERSION}"
PREFERRED_VERSION_gstreamer1.0-plugins-base = "${GSTREAMER_VERSION}"
PREFERRED_VERSION_gstreamer1.0-plugins-cool = "${GSTREAMER_VERSION}"
PREFERRED_VERSION_gstreamer1.0-plugins-good = "${GSTREAMER_VERSION}"
PREFERRED_VERSION_gstreamer1.0-plugins-ugly = "${GSTREAMER_VERSION}"
PREFERRED_VERSION_gstreamer1.0-libav        = "${GSTREAMER_VERSION}"
PREFERRED_VERSION_gstreamer1.0-omx          = "${GSTREAMER_VERSION}"
PREFERRED_VERSION_gstreamer1.0-python       = "${GSTREAMER_VERSION}"
PREFERRED_VERSION_gstreamer1.0-rtsp-server  = "${GSTREAMER_VERSION}"
PREFERRED_VERSION_gstreamer1.0-vaapi        = "${GSTREAMER_VERSION}"
PREFERRED_VERSION_gstreamer1.0-adaptive-ng  = "${GSTREAMER_VERSION}"
PREFERRED_VERSION_gst-devtools              = "${GSTREAMER_VERSION}"
PREFERRED_VERSION_gst-validate1.0           = "${GSTREAMER_VERSION}"
# gst-examples is not kept in sync with the rest of gst-* recipes
# PREFERRED_VERSION_gst-examples              = "${GSTREAMER_VERSION}"
```

## meta-webos/conf/distro/include/webos-recipe-blacklist-world.inc
```bitbake
# Copyright (c) 2013-2019 LG Electronics, Inc.

# A blacklisted recipe is ignored by bitbake. The reason it is useful to be able
# to have bitbake ignore a recipe is because, although PREFERRED_PROVIDER can be
# used to select which recipe is used to fulfill a build-time dependency, bitbake
# does not have a PREFERRED_RPROVIDER to allow specification of which package
# should be used to satisfy a run-time dependency. When two recipes both provide
# common packages, but one recipe provides additional packages that the other
# doesn't, then the only way to guarantee that the first recipe will never be
# used is to blacklist it.

PNBLACKLIST[vboxguestdrivers] ?= "unused in webOS world"

# Use webOS qt5 configuration
PNBLACKLIST[qwt-qt5] ?= "ERROR: Unknown module(s) in QT: printsupport opengl http://caprica.lgsvl.com:8080/Errors/Details/1509145"
PNBLACKLIST[libconnman-qt5] ?= "requires dbus module enabled in qtbase, which was disabled in PLAT-18268 http://caprica.lgsvl.com:8080/Errors/Details/1509142"
PNBLACKLIST[libqofono] ?= "requires dbus module enabled in qtbase, which was disabled in PLAT-18268 http://caprica.lgsvl.com:8080/Errors/Details/1509141"
PNBLACKLIST[qtwebkit] ?= "Could not find a package configuration file provided by Qt5Widgets, because widgets are disabled in our builds http://caprica.lgsvl.com:8080/Errors/Details/1509126"
PNBLACKLIST[maliit-framework-qt5] ?= "requires dbus module enabled in qtbase, which was disabled in PLAT-18268 http://caprica.lgsvl.com:8080/Errors/Details/1509125"
PNBLACKLIST[maliit-plugins-qt5] ?= "depends on blacklisted maliit-framework-qt5"
PNBLACKLIST[qt5-creator] ?= "depends on blacklisted qtwebkit"

PNBLACKLIST[kernel-devsrc] ?= "BROKEN for aarch64: make[4]: *** No rule to make target `kernel-devsrc/1.0-r0/image/usr/src/kernel/arch/arm64/boot/dts/broadcom/../overlays/Makefile'.  Stop http://caprica.lgsvl.com:8080/Errors/Details/1509158"
PNBLACKLIST[glmark2] ?= "broken: we don't build libGL with mesa: cannot find -lGL http://caprica.lgsvl.com:8080/Errors/Details/1509155"
PNBLACKLIST[sysstat] ?= "BROKEN: install: invalid group ‘man’ http://caprica.lgsvl.com:8080/Errors/Details/1509136"
PNBLACKLIST[man-db] ?= "BROKEN: without --disable-cache-owner: chown: invalid user: ?man:man? our passwd doesn't have man user and since http://git.openembedded.org/openembedded-core/commit/?id=7080df4b6bc50440eed600e81f2c6fa76a80623d it's needed http://caprica.lgsvl.com:8080/Errors/Details/1509154"
PNBLACKLIST[hplip] ?= "BROKEN: configure: error: could not force soft-float and chgrp: invalid group: ‘lp’ http://caprica.lgsvl.com:8080/Errors/Details/1509153"
PNBLACKLIST[gst-plugins-gl] ?= "GL/glew.h:1205:14: fatal error: GL/glu.h: No such file or directory http://caprica.lgsvl.com:8080/Errors/Details/1509152"
PNBLACKLIST[poppler] ?= "fails to generate GIR http://caprica.lgsvl.com:8080/Errors/Details/1509140"
PNBLACKLIST[s-suite] ?= "rdepends on blacklisted sysstat"
PNBLACKLIST[mongodb] ?= "src/mongo/util/net/ssl_manager.cpp:557:70: error: invalid conversion from 'size_t*' {aka 'unsigned int*'} to 'long unsigned int*' [-fpermissive] http://caprica.lgsvl.com:8080/Errors/Details/1509767"

# ERROR: QA Issue: ELF binary 'TOPDIR/BUILD/work/qemux86-webos-linux/x264/r2854+gitAUTOINC+e9a5903edf-r0/packages-split/x264/usr/lib/libx264.so.152' has relocations in .text [textrel] http://caprica.lgsvl.com:8080/Errors/Details/1509766
INSANE_SKIP_${PN}_pn-x264 = "textrel"

# QA Issue: ELF binary 'work/raspberrypi3-webos-linux-gnueabi/mpeg2dec/0.5.1-r0/packages-split/libmpeg2/usr/lib/libmpeg2.so.0.1.0' has relocations in .text
INSANE_SKIP_libmpeg2_pn-mpeg2dec += "textrel"

# from meta-ros:
# libxi was skipped: missing required distro feature 'x11' (not in DISTRO_FEATURES)
# libglu was skipped: missing required distro feature 'x11' (not in DISTRO_FEATURES)
# libxmu was skipped: missing required distro feature 'x11' (not in DISTRO_FEATURES)
PNBLACKLIST[libfreenect] ?= "depends on blacklisted libxi, freeglut, libxmu"
PNBLACKLIST[freeglut] ?= "depends on blacklisted libxi, libglu"
# gtk+ was skipped: one of '['directfb', 'x11']' needs to be in DISTRO_FEATURES
# libxinerama was skipped: missing required distro feature 'x11' (not in DISTRO_FEATURES)
PNBLACKLIST[wxwidgets] ?= "depends on blacklisted libxinerama, libglu, gtk, webkit-gtk"

PNBLACKLIST[wxpython] ?= "depends on blacklisted wxwidgets"
PNBLACKLIST[freenect-camera] ?= "depends on blacklisted libfreenect"
PNBLACKLIST[freenect-launch] ?= "rdepends on blacklisted freenect-camera"
PNBLACKLIST[realsense-camera] ?= "depends on librealsenese which is provided by meta-intel-realsense layer which we don't use, see https://github.com/bmwcarit/meta-ros/commit/7f889a8a53fa3febb7e5c51f6f408ddec83bbf26"
PNBLACKLIST[joint-state-publisher] ?= "depends on blacklisted wxpython"

# gst-plugins-ugly was skipped: because it has a restricted license not whitelisted in LICENSE_FLAGS_WHITELIST
PNBLACKLIST[sound-play] ?= "rdepends on blacklisted gst-plugins-ugly"

PNBLACKLIST[geographiclib] ?= "Broken, many unpackaged files http://caprica.lgsvl.com:8080/Errors/Details/1509150"
PNBLACKLIST[python-wstool] ?= "Broken, many unpackaged files http://caprica.lgsvl.com:8080/Errors/Details/1509151"
PNBLACKLIST[speech-tools] ?= "fails to fetch http://caprica.lgsvl.com:8080/Errors/Details/1509132"
PNBLACKLIST[festival] ?= "fails to fetch http://caprica.lgsvl.com:8080/Errors/Details/1509157"
PNBLACKLIST[image-view] ?= "missing gtk dependency http://caprica.lgsvl.com:8080/Errors/Details/1509137"
PNBLACKLIST[velodyne-pointcloud] ?= "fails to fetch http://caprica.lgsvl.com:8080/Errors/Details/1509135"
PNBLACKLIST[velodyne-driver] ?= "fails to fetch http://caprica.lgsvl.com:8080/Errors/Details/1509124"
PNBLACKLIST[velodyne-msgs] ?= "fails to fetch http://caprica.lgsvl.com:8080/Errors/Details/1509123"
PNBLACKLIST[ar-track-alvar] ?= "ar-track-alvar/0.6.1-r0/ar_track_alvar-0.6.1/include/ar_track_alvar/Draw.h:70:86: error: there are no arguments to 'CV_RGB' that depend on a template parameter, so a declaration of 'CV_RGB' must be available [-fpermissive] http://caprica.lgsvl.com:8080/Errors/Details/1509130"
PNBLACKLIST[yocs-localization-manager] ?= "rdepends on blacklisted ar-track-alvar"
PNBLACKLIST[python-orocos-kdl] ?= "depends on sip-native unavailable in our builds http://caprica.lgsvl.com:8080/Errors/Details/1509128"
PNBLACKLIST[kobuki-testsuite] ?= "depends on blacklisted python-orocos-kdl"
PNBLACKLIST[kdl-parser-py] ?= "depends on blacklisted python-orocos-kdl"

# NOTE: Multiple providers are available for runtime python-bson (python-bson, python-pymongo)
PNBLACKLIST[python-bson] ?= "Conflicts with python-pymongo"
```
