## meta-qt5-compat/conf/layer.conf
```bitbake
# Copyright (c) 2020 LG Electronics, Inc.

# We have conf and classes directories => add to BBPATH
BBPATH .= ":${LAYERDIR}"

# We have recipes-* directories => add to BBFILES
BBFILES += "${LAYERDIR}/recipes-*/*/*.bb \
            ${LAYERDIR}/recipes-*/*/*.bbappend"

BBFILE_COLLECTIONS += "meta-qt5-compat"
BBFILE_PATTERN_meta-qt5-compat := "^${LAYERDIR}/"
BBFILE_PRIORITY_meta-qt5-compat = "19"

LAYERSERIES_COMPAT_meta-qt5-compat = "dunfell"

LAYERDEPENDS_meta-qt5-compat = " \
    qt5-layer \
"

# We made the neccessary changes to make meta-qt5 compatible with meta-webos
LAYERSERIES_COMPAT_qt5-layer = "dunfell"
```

## meta-webos-backports/meta-webos-backports-2.3/conf/layer.conf
```bitbake
# Copyright (c) 2016-2017 LG Electronics, Inc.

# We have conf and classes directories => add to BBPATH
BBPATH .= ":${LAYERDIR}"

# We have recipes-* directories => add to BBFILES
BBFILES += "${LAYERDIR}/recipes-*/*/*.bb \
            ${LAYERDIR}/recipes-*/*/*.bbappend"

BBFILE_COLLECTIONS += "meta-webos-backports-2.3"
BBFILE_PATTERN_meta-webos-backports-2.3 := "^${LAYERDIR}/"
BBFILE_PRIORITY_meta-webos-backports-2.3 = "30"
```

## meta-webos-backports/meta-webos-backports-2.6/conf/layer.conf
```bitbake
# Copyright (c) 2018 LG Electronics, Inc.

# We have conf and classes directories => add to BBPATH
BBPATH .= ":${LAYERDIR}"

# We have recipes-* directories => add to BBFILES
BBFILES += "${LAYERDIR}/recipes-*/*/*.bb \
            ${LAYERDIR}/recipes-*/*/*.bbappend"

BBFILE_COLLECTIONS += "meta-webos-backports-2.6"
BBFILE_PATTERN_meta-webos-backports-2.6 := "^${LAYERDIR}/"
BBFILE_PRIORITY_meta-webos-backports-2.6 = "33"
```

## meta-webos-backports/meta-webos-backports-2.7/conf/layer.conf
```bitbake
# Copyright (c) 2019 LG Electronics, Inc.

# We have conf and classes directories => add to BBPATH
BBPATH .= ":${LAYERDIR}"

# We have recipes-* directories => add to BBFILES
BBFILES += "${LAYERDIR}/recipes-*/*/*.bb \
            ${LAYERDIR}/recipes-*/*/*.bbappend"

BBFILE_COLLECTIONS += "meta-webos-backports-2.7"
BBFILE_PATTERN_meta-webos-backports-2.7 := "^${LAYERDIR}/"
BBFILE_PRIORITY_meta-webos-backports-2.7 = "30"

LAYERSERIES_COMPAT_meta-webos-backports-2.7 = "thud"

# In warrior mkimage was integrated with other tools like mkenvimage to u-boot-tools recipe
# and for thud builds this was causing following NOTEs:
# NOTE: Multiple providers are available for u-boot-mkimage-native (u-boot-mkimage-native, u-boot-tools-native)
# Consider defining a PREFERRED_PROVIDER entry to match u-boot-mkimage-native
BBMASK += "recipes-bsp/u-boot/u-boot-mkimage_2018.07.bb"
```

## meta-webos-backports/meta-webos-backports-3.0/conf/layer.conf
```bitbake
# Copyright (c) 2019 LG Electronics, Inc.

# We have conf and classes directories => add to BBPATH
BBPATH .= ":${LAYERDIR}"

# We have recipes-* directories => add to BBFILES
BBFILES += "${LAYERDIR}/recipes-*/*/*.bb \
            ${LAYERDIR}/recipes-*/*/*.bbappend"

BBFILE_COLLECTIONS += "meta-webos-backports-3.0"
BBFILE_PATTERN_meta-webos-backports-3.0 := "^${LAYERDIR}/"
BBFILE_PRIORITY_meta-webos-backports-3.0 = "31"

LAYERSERIES_COMPAT_meta-webos-backports-3.0 = "thud"
```

## meta-webos-backports/meta-webos-backports-3.1/conf/layer.conf
```bitbake
# Copyright (c) 2020 LG Electronics, Inc.

# We have conf and classes directories => add to BBPATH
BBPATH .= ":${LAYERDIR}"

# We have recipes-* directories => add to BBFILES
BBFILES += "${LAYERDIR}/recipes-*/*/*.bb \
            ${LAYERDIR}/recipes-*/*/*.bbappend"

BBFILE_COLLECTIONS += "meta-webos-backports-3.1"
BBFILE_PATTERN_meta-webos-backports-3.1 := "^${LAYERDIR}/"
BBFILE_PRIORITY_meta-webos-backports-3.1 = "30"

LAYERSERIES_COMPAT_meta-webos-backports-3.1 = "zeus"
```

## meta-webos-backports/meta-webos-backports-3.2/conf/layer.conf
```bitbake
# Copyright (c) 2021-2022 LG Electronics, Inc.

# We have conf and classes directories => add to BBPATH
BBPATH .= ":${LAYERDIR}"

# We have recipes-* directories => add to BBFILES
BBFILES += "${LAYERDIR}/recipes-*/*/*.bb \
            ${LAYERDIR}/recipes-*/*/*.bbappend"

BBFILE_COLLECTIONS += "meta-webos-backports-3.2"
BBFILE_PATTERN_meta-webos-backports-3.2 := "^${LAYERDIR}/"

LAYERDEPENDS_meta-webos-backports-3.2 = " \
    core \
    openembedded-layer \
"
BBFILE_PRIORITY_meta-webos-backports-3.2 = "30"

LAYERSERIES_COMPAT_meta-webos-backports-3.2 = "dunfell"
```

## meta-webos-backports/meta-webos-backports-3.3/conf/layer.conf
```bitbake
# Copyright (c) 2021-2022 LG Electronics, Inc.

# We have conf and classes directories => add to BBPATH
BBPATH .= ":${LAYERDIR}"

# We have recipes-* directories => add to BBFILES
BBFILES += "${LAYERDIR}/recipes-*/*/*.bb \
            ${LAYERDIR}/recipes-*/*/*.bbappend"

BBFILE_COLLECTIONS += "meta-webos-backports-3.3"
BBFILE_PATTERN_meta-webos-backports-3.3 := "^${LAYERDIR}/"
BBFILE_PRIORITY_meta-webos-backports-3.3 = "34"

LAYERSERIES_COMPAT_meta-webos-backports-3.3 = "dunfell"

LAYERDEPENDS_meta-webos-backports-3.3 = " \
core \
openembedded-layer \
"

LICENSE_PATH += "${LAYERDIR}/licenses"

# NB: meta-qt6/conf/layer.conf has license mapping back to old license files:
# SPDXLICENSEMAP[GPL-3.0-only] = "GPL-3.0"
# SPDXLICENSEMAP[LGPL-3.0-only] = "LGPL-3.0"
# SPDXLICENSEMAP[GPL-2.0-or-later] = "GPL-2.0"
# which prevent using the new license identifiers and common-licenses added here
# and in oe-core
```

## meta-webos-backports/meta-webos-backports-3.4/conf/layer.conf
```bitbake
# Copyright (c) 2021-2022 LG Electronics, Inc.

# We have conf and classes directories => add to BBPATH
BBPATH .= ":${LAYERDIR}"

# We have recipes-* directories => add to BBFILES
BBFILES += "${LAYERDIR}/recipes-*/*/*.bb \
            ${LAYERDIR}/recipes-*/*/*.bbappend"

BBFILE_COLLECTIONS += "meta-webos-backports-3.4"
BBFILE_PATTERN_meta-webos-backports-3.4 := "^${LAYERDIR}/"
BBFILE_PRIORITY_meta-webos-backports-3.4 = "35"

LAYERSERIES_COMPAT_meta-webos-backports-3.4 = "dunfell"

LAYERDEPENDS_meta-webos-backports-3.4 = " \
    core \
    openembedded-layer \
"

LICENSE_PATH += "${LAYERDIR}/licenses"
```

## meta-webos-backports/meta-webos-backports-4.0/conf/layer.conf
```bitbake
# Copyright (c) 2022 LG Electronics, Inc.

# We have conf and classes directories => add to BBPATH
BBPATH .= ":${LAYERDIR}"

# We have recipes-* directories => add to BBFILES
BBFILES += "${LAYERDIR}/recipes-*/*/*.bb \
            ${LAYERDIR}/recipes-*/*/*.bbappend"

BBFILE_COLLECTIONS += "meta-webos-backports-4.0"
BBFILE_PATTERN_meta-webos-backports-4.0 := "^${LAYERDIR}/"
BBFILE_PRIORITY_meta-webos-backports-4.0 = "36"

LAYERSERIES_COMPAT_meta-webos-backports-4.0 = "gatesgarth"

LAYERDEPENDS_meta-webos-backports-4.0 = " \
    core \
    openembedded-layer \
"
```

## meta-webos-backports/meta-webos-backports-4.1/conf/layer.conf
```bitbake
# Copyright (c) 2022 LG Electronics, Inc.

# We have conf and classes directories => add to BBPATH
BBPATH .= ":${LAYERDIR}"

# We have recipes-* directories => add to BBFILES
BBFILES += "${LAYERDIR}/recipes-*/*/*.bb \
            ${LAYERDIR}/recipes-*/*/*.bbappend"

BBFILE_COLLECTIONS += "meta-webos-backports-4.1"
BBFILE_PATTERN_meta-webos-backports-4.1 := "^${LAYERDIR}/"
BBFILE_PRIORITY_meta-webos-backports-4.1 = "30"

LAYERSERIES_COMPAT_meta-webos-backports-4.1 = "kirkstone"

LAYERDEPENDS_meta-webos-backports-4.1 = " \
    core \
    openembedded-layer \
"
```

## meta-webos-backports/meta-webos-backports-4.2/conf/layer.conf
```bitbake
# Copyright (c) 2022-2025 LG Electronics, Inc.

# We have conf and classes directories => add to BBPATH
BBPATH .= ":${LAYERDIR}"

# We have recipes-* directories => add to BBFILES
BBFILES += "${LAYERDIR}/recipes-*/*/*.bb \
            ${LAYERDIR}/recipes-*/*/*.bbappend"

BBFILE_COLLECTIONS += "meta-webos-backports-4.2"
BBFILE_PATTERN_meta-webos-backports-4.2 := "^${LAYERDIR}/"
BBFILE_PRIORITY_meta-webos-backports-4.2 = "31"

LAYERSERIES_COMPAT_meta-webos-backports-4.2 = "langdale"

LAYERDEPENDS_meta-webos-backports-4.2 = " \
    core \
    openembedded-layer \
"

BBFILES_DYNAMIC += " \
    clang-layer:${LAYERDIR}/dynamic-layers/clang-layer/*/*.bb \
    clang-layer:${LAYERDIR}/dynamic-layers/clang-layer/*/*.bbappend \
"
```

## meta-webos-backports/meta-webos-backports-4.3/conf/distro/include/yocto-uninative.inc
```bitbake
# Backport 4.1 version from oe-core master as-is in:
# https://git.openembedded.org/openembedded-core/commit/?id=1c5c8ff97ba0a7f9adc592d702b865b3d166a24b
# and 4.2 version in:
# https://git.openembedded.org/openembedded-core/commit/?id=c6654fab00a1b4e4bb05eec8b77c8c60e1f8a709
# and 4.3 version in:
# https://git.openembedded.org/openembedded-core/commit/?id=39f987fcb20ad7c0e45425b9f508d463c50ce0c1
#
# This include points at uninative tarballs generated and maintained
# by the Yocto Project. These file can be included by distros if they
# want to use/maintain a unified sstate feed for native/cross artefacts
# rather than the feeds having native/cross artefacts which are specific
# to the distro running on the build machine.
#

UNINATIVE_MAXGLIBCVERSION = "2.38"
UNINATIVE_VERSION = "4.3"

UNINATIVE_URL ?= "http://downloads.yoctoproject.org/releases/uninative/${UNINATIVE_VERSION}/"
UNINATIVE_CHECKSUM[aarch64] ?= "8df05f4a41455018b4303b2e0ea4eac5c960b5a13713f6dbb33dfdb3e32753ec"
UNINATIVE_CHECKSUM[i686] ?= "bea76b4a97c9ba0077c0dd1295f519cd599dbf71f0ca1c964471c4cdb043addd"
UNINATIVE_CHECKSUM[x86_64] ?= "1c35f09a75c4096749bbe1e009df4e3968cde151424062cf4aa3ed89db22b030"
```

## meta-webos-backports/meta-webos-backports-4.3/conf/layer.conf
```bitbake
# Copyright (c) 2022-2025 LG Electronics, Inc.

# We have conf and classes directories => add to BBPATH
BBPATH .= ":${LAYERDIR}"

# We have recipes-* directories => add to BBFILES
BBFILES += "${LAYERDIR}/recipes-*/*/*.bb \
            ${LAYERDIR}/recipes-*/*/*.bbappend"

BBFILE_COLLECTIONS += "meta-webos-backports-4.3"
BBFILE_PATTERN_meta-webos-backports-4.3 := "^${LAYERDIR}/"
BBFILE_PRIORITY_meta-webos-backports-4.3 = "32"

LAYERSERIES_COMPAT_meta-webos-backports-4.3 = "mickledore"

LAYERDEPENDS_meta-webos-backports-4.3 = " \
    core \
    openembedded-layer \
"

BBFILES_DYNAMIC += " \
    clang-layer:${LAYERDIR}/dynamic-layers/clang-layer/*/*/*.bb \
    clang-layer:${LAYERDIR}/dynamic-layers/clang-layer/*/*/*.bbappend \
"
```

## meta-webos-backports/meta-webos-backports-5.0/conf/distro/include/yocto-uninative.inc
```bitbake
# Backport 4.1 version from oe-core master as-is in:
# https://git.openembedded.org/openembedded-core/commit/?id=1c5c8ff97ba0a7f9adc592d702b865b3d166a24b
# and 4.2 version in:
# https://git.openembedded.org/openembedded-core/commit/?id=c6654fab00a1b4e4bb05eec8b77c8c60e1f8a709
# and 4.3 version in:
# https://git.openembedded.org/openembedded-core/commit/?id=39f987fcb20ad7c0e45425b9f508d463c50ce0c1
# and 4.4 version in:
# https://git.openembedded.org/openembedded-core/commit/?id=56fdd8b79e2f7ec30d2cdcfa0c399a6553efac1e
#
# This include points at uninative tarballs generated and maintained
# by the Yocto Project. These file can be included by distros if they
# want to use/maintain a unified sstate feed for native/cross artefacts
# rather than the feeds having native/cross artefacts which are specific
# to the distro running on the build machine.
#

UNINATIVE_MAXGLIBCVERSION = "2.39"
UNINATIVE_VERSION = "4.4"

UNINATIVE_URL ?= "http://downloads.yoctoproject.org/releases/uninative/${UNINATIVE_VERSION}/"
UNINATIVE_CHECKSUM[aarch64] ?= "b61876130f494f75092f21086b4a64ea5fb064045769bf1d32e9cb6af17ea8ec"
UNINATIVE_CHECKSUM[i686] ?= "9f28627828f0082cc0344eede4d9a861a9a064bfa8f36e072e46212f0fe45fcc"
UNINATIVE_CHECKSUM[x86_64] ?= "d81c54284be2bb886931fc87281d58177a2cd381cf99d1981f8923039a72a302"
```

## meta-webos-backports/meta-webos-backports-5.0/conf/layer.conf
```bitbake
# Copyright (c) 2023-2024 LG Electronics, Inc.

# We have conf and classes directories => add to BBPATH
BBPATH .= ":${LAYERDIR}"

# We have recipes-* directories => add to BBFILES
BBFILES += "${LAYERDIR}/recipes-*/*/*.bb \
            ${LAYERDIR}/recipes-*/*/*.bbappend"

BBFILE_COLLECTIONS += "meta-webos-backports-5.0"
BBFILE_PATTERN_meta-webos-backports-5.0 := "^${LAYERDIR}/"
BBFILE_PRIORITY_meta-webos-backports-5.0 = "33"

LAYERSERIES_COMPAT_meta-webos-backports-5.0 = "kirkstone"

LAYERDEPENDS_meta-webos-backports-5.0 = " \
    core \
    openembedded-layer \
"

SKIP_RECIPE[rust-hello-world] ?= "BROKEN: doesn't build since rust and related bbclasses were updated by this layer, already removed in newer oe-core/nanbield"
```

## meta-webos-backports/meta-webos-backports-5.1/conf/layer.conf
```bitbake
# Copyright (c) 2024-2025 LG Electronics, Inc.

# We have conf and classes directories => add to BBPATH
BBPATH .= ":${LAYERDIR}"

# We have recipes-* directories => add to BBFILES
BBFILES += "${LAYERDIR}/recipes-*/*/*.bb \
            ${LAYERDIR}/recipes-*/*/*.bbappend"

BBFILE_COLLECTIONS += "meta-webos-backports-5.1"
BBFILE_PATTERN_meta-webos-backports-5.1 := "^${LAYERDIR}/"
BBFILE_PRIORITY_meta-webos-backports-5.1 = "34"

LAYERSERIES_COMPAT_meta-webos-backports-5.1 = "nanbield"

LAYERDEPENDS_meta-webos-backports-5.1 = " \
    core \
    openembedded-layer \
"

BBFILES_DYNAMIC += " \
    raspberrypi:${LAYERDIR}/dynamic-layers/raspberrypi/*/*/*.bb \
    raspberrypi:${LAYERDIR}/dynamic-layers/raspberrypi/*/*/*.bbappend \
"

# We need to BBMASK the other 6.1.77 recipe from upstream meta-raspberrypi
# because now when they have the same PV, then PREFERRED_VERSION doesn't
# allow us to use the version from meta-webos-backports and the one
# from upstream meta-raspberrypi (which has priority 50 in our builds
# while this meta-webos-backports-5.1 layer only 34) is missing
# android-driver.cfg update from:
# https://github.com/agherzan/meta-raspberrypi/pull/1351
# Similarly with 6.6 in scarthgap builds.
BBMASK += "meta-raspberrypi/recipes-kernel/linux/linux-raspberrypi_6.1.bb"
BBMASK += "meta-raspberrypi/recipes-kernel/linux/linux-raspberrypi_6.6.bb"
```

## meta-webos-backports/meta-webos-backports-5.2/conf/layer.conf
```bitbake
# Copyright (c) 2024-2025 LG Electronics, Inc.

# We have conf and classes directories => add to BBPATH
BBPATH .= ":${LAYERDIR}"

# We have recipes-* directories => add to BBFILES
BBFILES += "${LAYERDIR}/recipes-*/*/*.bb \
            ${LAYERDIR}/recipes-*/*/*.bbappend"

BBFILE_COLLECTIONS += "meta-webos-backports-5.2"
BBFILE_PATTERN_meta-webos-backports-5.2 := "^${LAYERDIR}/"
BBFILE_PRIORITY_meta-webos-backports-5.2 = "35"

LAYERSERIES_COMPAT_meta-webos-backports-5.2 = "nanbield"

LAYERDEPENDS_meta-webos-backports-5.2 = " \
    core \
    openembedded-layer \
"
```

## meta-webos-iot/conf/layer.conf
```bitbake
# Copyright (c) 2020-2022 LG Electronics, Inc.

BBPATH ?= ""
# We have a conf and classes directory, add to BBPATH
BBPATH .= ":${LAYERDIR}"
# We have a packages directory, add to BBFILES
BBFILES += "${LAYERDIR}/recipes-*/*/*.bb ${LAYERDIR}/recipes-*/*/*.bbappend"

BBFILE_COLLECTIONS += "meta-webos-iot"
BBFILE_PATTERN_meta-webos-iot := "^${LAYERDIR}/"
BBFILE_PRIORITY_meta-webos-iot = "70"

LAYERSERIES_COMPAT_meta-webos-iot = "hardknott"

LAYERDEPENDS_meta-webos-iot = " \
    meta-webos \
"
```

## meta-webos-qatools/conf/layer.conf
```bitbake
# Copyright (c) 2020 LG Electronics, Inc.

BBPATH ?= ""
# We have a conf and classes directory, add to BBPATH
BBPATH .= ":${LAYERDIR}"
# We have a packages directory, add to BBFILES
BBFILES += "${LAYERDIR}/recipes-*/*/*.bb ${LAYERDIR}/recipes-*/*/*.bbappend"

BBFILE_COLLECTIONS += "meta-webos-qatools"
BBFILE_PATTERN_meta-webos-qatools := "^${LAYERDIR}/"
BBFILE_PRIORITY_meta-webos-qatools = "90"

LAYERSERIES_COMPAT_meta-webos-qatools = "thud"

# Add extra license path
LICENSE_PATH += "${LAYERDIR}/licenses"

require webos-qatools.conf
```
