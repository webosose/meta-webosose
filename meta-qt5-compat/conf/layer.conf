## meta-webos-raspberrypi/conf/layer.conf
```bitbake
# Copyright (c) 2017-2025 LG Electronics, Inc.

BBPATH ?= ""
# We have a conf and classes directory, add to BBPATH
BBPATH .= ":${LAYERDIR}"
# We have a packages directory, add to BBFILES
BBFILES += "${LAYERDIR}/recipes-*/*/*.bb ${LAYERDIR}/recipes-*/*/*.bbappend"

BBFILE_COLLECTIONS += "meta-webos-raspberrypi"
BBFILE_PATTERN_meta-webos-raspberrypi := "^${LAYERDIR}/"
BBFILE_PRIORITY_meta-webos-raspberrypi = "51"

LAYERSERIES_COMPAT_meta-webos-raspberrypi = "langdale"

LAYERDEPENDS_meta-webos-raspberrypi = "\
    meta-webos \
    raspberrypi \
"

BBFILES_DYNAMIC += " \
    qt6-layer:${LAYERDIR}/dynamic-layers/qt6-layer/*/*/*.bb \
    qt6-layer:${LAYERDIR}/dynamic-layers/qt6-layer/*/*/*.bbappend \
"

# Not compatible with our old Qt 5.6
BBMASK += "meta-raspberrypi/dynamic-layers/qt5-layer/recipes-qt/qt5/qtbase_%.bbappend"
```

## meta-webos-raspberrypi/conf/machine/include/webos-rpi.inc
```bitbake
# Copyright (c) 2017-2025 LG Electronics, Inc.

# The MACHINE.conf for every MACHINE that has an Raspberry Pi BSP must require this
# file.

# All the MACHINE-s supported by this layer are real pieces of hardware.
WEBOS_TARGET_MACHINE_IMPL = "hardware"

MACHINE_FEATURES += "webos-armnn webos-auto-acceleration webos-edgetpu webos-gpu-delegate webos-gl-backend webos-graphics-drm"

# Below setting is worked with rpi-config_git.bb
# Set gpu memory to "300M"
# When use default setting (64M), we got the below error
# [EXIT]: EGL Error : Could not create the egl surface: error = 0x3003
GPU_MEM = "300"
# Set for I2C support
ENABLE_I2C:raspberrypi4 = "1"
# Set for SPI bus support
ENABLE_SPI_BUS:raspberrypi4 = "1"
# Set for video/camera support
VIDEO_CAMERA:raspberrypi4 = "1"
# Set for mic array
USE_MIC_ARRAY:raspberrypi4 = "1"
RPI_KERNEL_MODULES_FOR_MIC_ARRAY = " \
    kernel-module-snd-soc-ac108 \
    kernel-module-snd-soc-bcm2835-i2s \
    kernel-module-snd-soc-seeed-voicecard \
"
RPI_KERNEL_DEVICETREE_OVERLAYS_FOR_MIC_ARRAY = " \
    overlays/seeed-4mic-voicecard.dtbo \
    overlays/seeed-8mic-voicecard.dtbo \
"

SKIP_RECIPE[omxplayer] ?= "not compatible with webOS Open components"
SKIP_RECIPE[packagegroup-rpi-test] ?= "rdepends on omxplayer"
SKIP_RECIPE[rpi-test-image] ?= "rdepends on packagegroup-rpi-test"

MACHINE_EXTRA_RRECOMMENDS:remove = "kernel-modules"
MACHINE_ESSENTIAL_EXTRA_RRECOMMENDS:remove = "kernel-modules"
MACHINE_ESSENTIAL_EXTRA_RRECOMMENDS:append = " ${RPI_KERNEL_MODULES}"
RPI_KERNEL_MODULES = " \
    kernel-module-bcm2835-wdt \
    kernel-module-bluetooth \
    kernel-module-brcmfmac \
    kernel-module-brcmfmac-wcc \
    kernel-module-bridge \
    kernel-module-btbcm \
    kernel-module-btusb \
    kernel-module-configs \
    kernel-module-evdev \
    kernel-module-hci-uart \
    kernel-module-hid-multitouch \
    kernel-module-hid-sony \
    kernel-module-hmac \
    kernel-module-i2c-bcm2708 \
    kernel-module-media \
    kernel-module-raspberrypi-gpiomem \
    kernel-module-rfcomm \
    kernel-module-snd-bcm2835 \
    kernel-module-snd-usb-audio \
    kernel-module-uinput \
    kernel-module-uvcvideo \
    kernel-module-vc4 \
    kernel-module-videodev \
    kernel-module-xpad \
"
# Few more modules which are automatically loaded on
# raspberrypi4 when all kernel-modules are installed
RPI_KERNEL_MODULES:append:raspberrypi4 = " \
    kernel-module-8021q \
    kernel-module-bcm2835-codec \
    kernel-module-bcm2835-v4l2 \
    kernel-module-bnep \
    kernel-module-cdc-ether \
    kernel-module-cifs \
    kernel-module-cmac \
    kernel-module-fixed \
    kernel-module-joydev \
    kernel-module-libarc4 \
    kernel-module-md4 \
    kernel-module-raspberrypi-hwmon \
    kernel-module-rpivid-mem \
    kernel-module-sch-fq-codel \
    kernel-module-uio-pdrv-genirq \
    kernel-module-v3d \
    ${@bb.utils.contains('USE_MIC_ARRAY', '1', '${RPI_KERNEL_MODULES_FOR_MIC_ARRAY}', '', d)} \
"

RPI_KERNEL_DEVICETREE_OVERLAYS:append = " \
    ${@bb.utils.contains('USE_MIC_ARRAY', '1', '${RPI_KERNEL_DEVICETREE_OVERLAYS_FOR_MIC_ARRAY}', '', d)} \
"

KERNEL_MODULE_AUTOLOAD:append = " uinput bridge hmac vc4"

# Always enable u-boot
RPI_USE_U_BOOT = "1"

# Always deploy the VFAT partition
SDIMG_VFAT_DEPLOY = "1"

ENABLE_UART = "1"

# Otherwise there are black bars around the screen and touchscreen calibration then doesn't match with the rendered screen in some setups
DISABLE_OVERSCAN = "1"

# Configure all Bluetooth service classes we want to support
WEBOS_BLUETOOTH_ENABLED_SERVICE_CLASSES = "SPP GATT FTP OPP A2DP"

# Use ext4 as a uSD rootfs type and don't build ext3
SDIMG_ROOTFS_TYPE = "ext4"
IMAGE_FSTYPES:remove = "ext3"

# Use Fake KMS until surface-manager is fixed to support Full KMS, see WRP-5
VC4DTBO = "vc4-fkms-v3d"
```

## meta-webos-raspberrypi/conf/machine/raspberrypi3.conf
```bitbake
# Copyright (c) 2017-2019 LG Electronics, Inc.

#@TYPE: Machine
#@NAME: RaspberryPi 3 Development Board
#@DESCRIPTION: Machine configuration for the RaspberryPi 3

DEFAULTTUNE ?= "cortexa7thf-neon-vfpv4"
require conf/machine/include/tune-cortexa7.inc
include conf/machine/include/rpi-base.inc

MACHINE_EXTRA_RRECOMMENDS += "\
    linux-firmware-bcm43430 \
    linux-firmware-bcm43455 \
    linux-firmware-bcm43430a1-hcd \
    linux-firmware-bcm4345c0-hcd \
"

SDIMG_KERNELIMAGE ?= "kernel7.img"
UBOOT_MACHINE = "rpi_3_32b_config"
SERIAL_CONSOLE ?= "115200 ttyS0"
VC4_CMA_SIZE ?= ""

MACHINE_FEATURES_append = " vc4graphics"
VC4DTBO = "vc4-kms-v3d"
DISABLE_OVERSCAN = "1"
require conf/machine/include/webos-rpi.inc

# Until LSM is fixed to work correctly with fkms PLAT-47626
PREFERRED_VERSION_linux-raspberrypi = "4.4.%"

# These came from meta-raspberrypi morty(2a19226) for fixing compile error with old 4.4 kernel
RPI_KERNEL_DEVICETREE_OVERLAYS = " \
    overlays/hifiberry-amp.dtbo \
    overlays/hifiberry-dac.dtbo \
    overlays/hifiberry-dacplus.dtbo \
    overlays/hifiberry-digi.dtbo \
    overlays/i2c-rtc.dtbo \
    overlays/iqaudio-dac.dtbo \
    overlays/iqaudio-dacplus.dtbo \
    overlays/lirc-rpi.dtbo \
    overlays/pitft22.dtbo \
    overlays/pitft28-resistive.dtbo \
    overlays/pps-gpio.dtbo \
    overlays/rpi-ft5406.dtbo \
    overlays/w1-gpio.dtbo \
    overlays/w1-gpio-pullup.dtbo \
    overlays/pi3-disable-bt.dtbo \
    overlays/pi3-miniuart-bt.dtbo \
    overlays/vc4-kms-v3d.dtbo \
"

# These came from meta-raspberrypi morty(2a19226) for fixing compile error with old 4.4 kernel
RPI_KERNEL_DEVICETREE = " \
    bcm2708-rpi-0-w.dtb \
    bcm2708-rpi-b.dtb \
    bcm2708-rpi-b-plus.dtb \
    bcm2709-rpi-2-b.dtb \
    bcm2710-rpi-3-b.dtb \
    bcm2708-rpi-cm.dtb \
    bcm2710-rpi-cm3.dtb \
"

KERNEL_DEVICETREE = " \
    ${RPI_KERNEL_DEVICETREE} \
    ${RPI_KERNEL_DEVICETREE_OVERLAYS} \
"
```

## meta-webos-raspberrypi/conf/machine/raspberrypi4-64.conf
```bitbake
# Copyright (c) 2019-2025 LG Electronics, Inc.

# This came from meta-raspberrypi for cumstomizing in webOS.
# It should be modified when meta-raspberrypi is updated.
require ${META_RASPBERRYPI_LAYER}/conf/machine/raspberrypi4-64.conf

require conf/machine/include/webos-rpi.inc
```

## meta-webos-raspberrypi/conf/machine/raspberrypi4.conf
```bitbake
# Copyright (c) 2017-2025 LG Electronics, Inc.

# This came from meta-raspberrypi for cumstomizing in webOS.
# It should be modified when meta-raspberrypi is updated.
require ${META_RASPBERRYPI_LAYER}/conf/machine/raspberrypi4.conf

require conf/machine/include/webos-rpi.inc
```
