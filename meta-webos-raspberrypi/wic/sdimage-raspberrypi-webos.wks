## meta-webos-raspberrypi/wic/sdimage-raspberrypi-webos.wks
```
# short-description: Create Raspberry Pi SD card image
# long-description: Creates a partitioned SD card image for use with
# Raspberry Pi. Boot files are located in the first vfat partition.

part /boot --source bootimg-partition --ondisk mmcblk0 --fstype=vfat --label boot --active --align 4096 --fixed-size 80M
part / --source rootfs --ondisk mmcblk0 --fstype=ext4 --label root --align 4096
```

## meta-webos-ros/conf/layer.conf
```bitbake
# Copyright (c) 2018 LG Electronics, Inc.

BBPATH ?= ""
# We have a conf and classes directory, add to BBPATH
BBPATH .= ":${LAYERDIR}"
# We have a packages directory, add to BBFILES
BBFILES += "${LAYERDIR}/recipes-*/*/*.bb ${LAYERDIR}/recipes-*/*/*.bbappend"

BBFILE_COLLECTIONS += "meta-webos-ros"
BBFILE_PATTERN_meta-webos-ros := "^${LAYERDIR}/"
BBFILE_PRIORITY_meta-webos-ros= "52"

LAYERSERIES_COMPAT_meta-webos-ros = "thud"

PNBLACKLIST[python-orocos-kdl] ?= "depends on sip-native unavailable in our builds http://caprica.lgsvl.com:8080/Errors/Details/1509128"
PNBLACKLIST[kobuki-testsuite] ?= "depends on blacklisted python-orocos-kdl"
PNBLACKLIST[kdl-parser-py] ?= "depends on blacklisted python-orocos-kdl"
```

## meta-webos-smack/conf/layer.conf
```bitbake
# Copyright (c) 2019-2022 LG Electronics, Inc.

# We have a conf and classes directory, add to BBPATH
BBPATH =. "${LAYERDIR}:"

# We have a packages directory, add to BBFILES
BBFILES += "${LAYERDIR}/recipes-*/*/*.bb ${LAYERDIR}/recipes-*/*/*.bbappend"

# Exclude unused recipies from meta-security, use only smack
BBMASK:append = " meta-security\/(?!.*\/smack\/).*"
# Disable the check added in: https://git.yoctoproject.org/cgit/cgit.cgi/meta-security/commit/?id=c1235f6affb5c38e64b3a04533b8388969b194b2
SKIP_META_SECURITY_SANITY_CHECK = "1"

PNBLACKLIST[crun] ?= "Depends on libseccomp which is provided by meta-security, but meta-webos-smack/conf/layer.conf BBMASKs everything from meta-security except smack itself"
PNBLACKLIST[slirp4netns] ?= "Depends on libseccomp which is provided by meta-security, but meta-webos-smack/conf/layer.conf BBMASKs everything from meta-security except smack itself"
PNBLACKLIST[podman] ?= "Depends on libseccomp which is provided by meta-security, but meta-webos-smack/conf/layer.conf BBMASKs everything from meta-security except smack itself"
PNBLACKLIST[packagegroup-container] ?= "Depends on podman which depends on libseccomp which is provided by meta-security, but meta-webos-smack/conf/layer.conf BBMASKs everything from meta-security except smack itself"

BBFILE_COLLECTIONS += "meta-webos-smack"
BBFILE_PATTERN_meta-webos-smack := "^${LAYERDIR}/"
BBFILE_PRIORITY_meta-webos-smack = "75"

LAYERSERIES_COMPAT_meta-webos-smack = "honister"

LAYERDEPENDS_meta-webos-smack = "\
    meta-webos \
    security \
"

# Remove openembedded-layer perl-layer networking-layer meta-python
# dependencies from meta-security layer
LAYERDEPENDS_security = "core"
```

## meta-webos-updater/conf/distro/sota.conf.inc
```bitbake
# based on https://github.com/shr-project/meta-updater/blob/31a770d3c0cb22c9f4ece068208d2e6b2c28f1ee/conf/distro/sota.conf.inc#L15
# but without reproducible_build_simple in INHERIT as it was removed from oe-core in:
# https://git.openembedded.org/openembedded-core/commit/?id=f38a8de19550ae216575b5b39163666f74b07e2d
# also remove reproducible_build removal as it's not included by default as well since:
# https://git.openembedded.org/openembedded-core/commit/?id=abb0671d2cebfd7e8df94796404bbe9c7f961058
# and image-prelink removed in:
# https://git.openembedded.org/openembedded-core/commit/?id=f9719cc1c3fe9d380336e7af418daf27473b2e8b
# and sha256sum is already in HOSTTOOLS as well:
# https://git.openembedded.org/openembedded-core/commit/?id=d0d3abdf9e2dec57f3849813faa5e7e3d34b83a4
# and git was included since the initial HOSTTOOLS implementation in:
# https://git.openembedded.org/openembedded-core/commit/?id=fa764a403da34bb0ca9fa3767a9e9dba8d685965
# Apply https://github.com/uptane/meta-updater/pull/35

# Common settings to enable SOTA
# This can be pulled into a custom distribution, or included in
# local.conf directly with:
#
# require conf/distro/sota.conf.inc

DISTRO_FEATURES:append = " sota usrmerge"
DISTRO_FEATURES_NATIVE:append = " sota"
INHERIT += " sota"

HOSTTOOLS += "sync"
HOSTTOOLS_NONFATAL += "java repo"
```

## meta-webos-updater/conf/layer.conf
```bitbake
# Copyright (c) 2019-2022 LG Electronics, Inc.

BBPATH ?= ""
# We have a conf and classes directory, add to BBPATH
BBPATH .= ":${LAYERDIR}"
# We have a packages directory, add to BBFILES
BBFILES += "${LAYERDIR}/recipes-*/*/*.bb ${LAYERDIR}/recipes-*/*/*.bbappend"

BBFILE_COLLECTIONS += "meta-webos-updater"
BBFILE_PATTERN_meta-webos-updater := "^${LAYERDIR}/"
BBFILE_PRIORITY_meta-webos-updater= "52"

LAYERSERIES_COMPAT_meta-webos-updater = "kirkstone"

LAYERDEPENDS_meta-webos-updater = "\
    sota \
    meta-webos \
"

# Remove python added by meta-updater, see:
# https://github.com/advancedtelematic/meta-updater/issues/684
HOSTTOOLS_NONFATAL:remove = "python"
```

## meta-webos-virtualization/conf/layer.conf
```bitbake
# Copyright (c) 2019-2025 LG Electronics, Inc.

BBPATH ?= ""
# We have a conf and classes directory, add to BBPATH
BBPATH .= ":${LAYERDIR}"
# We have a packages directory, add to BBFILES
BBFILES += "${LAYERDIR}/recipes-*/*/*.bb ${LAYERDIR}/recipes-*/*/*.bbappend"

BBFILE_COLLECTIONS += "meta-webos-virtualization"
BBFILE_PATTERN_meta-webos-virtualization := "^${LAYERDIR}/"
BBFILE_PRIORITY_meta-webos-virtualization = "53"

LAYERSERIES_COMPAT_meta-webos-virtualization = "kirkstone"

LAYERDEPENDS_meta-webos-virtualization = "\
    virtualization-layer \
    meta-webos \
"
```

## meta-webos/conf/distro/include/features/webos-features-core-boot.inc
```bitbake
# Copyright (c) 2012-2023 LG Electronics, Inc.

require conf/distro/include/webos.inc

# Increament when features are changed
_pr_suffix .= ".0"

# Keep in sync with setting in oe-core/meta/conf/distro/include/default-distrovars.inc
# TODO: Maybe change this to use "_remove" when it's introduced in bitbake

# Split some features to separate variables
# Remove argp (not used in OE anymore) and x11 (not needed for webOS OSE)
WEBOS_DISTRO_FEATURES_DEFAULT = "debuginfod"
WEBOS_DISTRO_FEATURES_OPENGL = "opengl"
WEBOS_DISTRO_FEATURES_WINDOW_SYSTEM = ""
# Remove pci pcmcia
WEBOS_DISTRO_FEATURES_BUSES = ""
WEBOS_DISTRO_FEATURES_USB = ""
WEBOS_DISTRO_FEATURES_CONNECTIVITY = "wifi"
WEBOS_DISTRO_FEATURES_NETWORKING = ""

WEBOS_DISTRO_FEATURES_INIT = "systemd"
WEBOS_DISTRO_FEATURES_INIT_CONSIDERED = "sysvinit"

DISTRO_FEATURES_BACKFILL_CONSIDERED += "${WEBOS_DISTRO_FEATURES_INIT_CONSIDERED}"

WEBOS_DISTRO_FEATURES_LD = "ld-is-gold"

WEBOS_DISTRO_FEATURES_TEST = "ptest"

DISTRO_FEATURES = " \
  ${WEBOS_DISTRO_FEATURES_DEFAULT} \
  ${WEBOS_DISTRO_FEATURES_OPENGL} \
  ${WEBOS_DISTRO_FEATURES_WINDOW_SYSTEM} \
  ${WEBOS_DISTRO_FEATURES_BUSES} \
  ${WEBOS_DISTRO_FEATURES_USB} \
  ${WEBOS_DISTRO_FEATURES_CONNECTIVITY} \
  ${WEBOS_DISTRO_FEATURES_NETWORKING} \
  ${WEBOS_DISTRO_FEATURES_LD} \
  ${WEBOS_DISTRO_FEATURES_INIT} \
  ${WEBOS_DISTRO_FEATURES_TEST} \
"

# We won't use webos's initscripts for core-boot profile
VIRTUAL-RUNTIME_initscripts = ""
PREFERRED_RPROVIDER_initd-functions = ""

# Additional image features
IMAGE_FEATURES += ""

# Do not install recommended packages as default
NO_RECOMMENDATIONS ?= "1"
```

## meta-webos/conf/distro/include/features/webos-features-headless.inc
```bitbake
# Copyright (c) 2024 LG Electronics, Inc.

require conf/distro/include/features/webos-features-core-boot.inc

# Increment when features are changed
_pr_suffix .= ".3"

# Addition/removal distro features
WEBOS_DISTRO_FEATURES_DEFAULT += "ext2 irda largefile xattr"
WEBOS_DISTRO_FEATURES_USB += "usbhost usbgadget"
WEBOS_DISTRO_FEATURES_CONNECTIVITY += "bluetooth ipv6"
WEBOS_DISTRO_FEATURES_NETWORKING += "nfs zeroconf"

# You can specify extra webos distro features.
WEBOS_DISTRO_FEATURES_EXTENDED = "webos-essential"
DISTRO_FEATURES:append = " ${WEBOS_DISTRO_FEATURES_EXTENDED}"

# This one is needed for native as well, use separate variable for that
WEBOS_DISTRO_FEATURES_QT ?= "webos-qt"

# Also have to add webos-qt to distro features native and nativesdk, if not
# | ERROR: Required build target 'nativesdk-packagegroup-sdk-host' has no buildable providers.
# | Missing or unbuildable dependency chain was: ['nativesdk-packagegroup-sdk-host', 'nativesdk-qtwayland-tools']
#
# | ERROR: Nothing PROVIDES 'qtwayland-native' (but qtwayland-webos.bb DEPENDS on or otherwise requires it)
# | qtwayland-native was skipped: missing required distro feature 'webos-qt' (not in DISTRO_FEATURES)
DISTRO_FEATURES:append = " ${WEBOS_DISTRO_FEATURES_QT}"
DISTRO_FEATURES_NATIVE:append = " ${WEBOS_DISTRO_FEATURES_QT}"
DISTRO_FEATURES_NATIVESDK:append = " ${WEBOS_DISTRO_FEATURES_QT}"

# Addition/removal preferred provider or version
VIRTUAL-RUNTIME_initscripts = "webos-initscripts"
PREFERRED_RPROVIDER_initd-functions = "webos-initscripts"

# Addition/removal image features
IMAGE_FEATURES += "${@ 'webos-extract-ls2-api webos-validate-ls2-conf' if bb.data.inherits_class('webos_image', d) else ''}"
```

## meta-webos/conf/distro/include/features/webos-features-minimal.inc
```bitbake
# Copyright (c) 2012-2024 LG Electronics, Inc.

require conf/distro/include/features/webos-features-headless.inc

# Increment when features are changed
_pr_suffix .= ".6"

# Addition/removal distro features
WEBOS_DISTRO_FEATURES_DEFAULT += "alsa"
WEBOS_DISTRO_FEATURES_OPENGL += "opengl"
WEBOS_DISTRO_FEATURES_WINDOW_SYSTEM += "wayland"
WEBOS_DISTRO_FEATURES_GRAPHICS_BACKEND = "graphics-drm"

# You can specify extra webos distro features.
WEBOS_DISTRO_FEATURES_EXTENDED += "webos-graphics webos-touch"

# Addition/removal image features
IMAGE_FEATURES += "${@ 'webos-minimal' if bb.data.inherits_class('webos_image', d) else ''}"
```

## meta-webos/conf/distro/include/features/webos-features-normal.inc
```bitbake
# Copyright (c) 2023-2024 LG Electronics, Inc.

require conf/distro/include/features/webos-features-minimal.inc

# Increment when features are changed
_pr_suffix .= ".4"

# Addition/removal distro features
WEBOS_DISTRO_FEATURES_EXTENDED += "virtualization"

# You can specify the packagegroups to be installed using the following options:
# webos-<feature>: If this feature is specified, packagegroup-webos-<feature> will be installed.
WEBOS_DISTRO_FEATURES_EXTENDED += "\
  webos-audio \
  webos-bluetooth \
  webos-camera \
  webos-connectivity \
  webos-diagnostics \
  webos-graphics-extended \
  webos-i18n \
  webos-media \
  webos-media-drm \
  webos-screencast \
"

# Includes AI Framework. You can specify the packages to be installed using the following options:
# webos-aiframework: If this feature is specified, tensorflow-lite, opencv, opencl, edgeai-vision will be installed.
# webos-armnn: Arm's ML SDKs arm-compute-library and armnn are installed. Along with this, the TFLite armnn-delegate for TFLite is installed.
# webos-gpu-delegate: If the installation machine supports gpu acceleration, TFLite will build with the gpu delegate function.
# webos-auto-acceleration: When this feature is added, the tflite-auto-delegation feature is enabled.
# webos-edgetpu: Install libraries for Google Coral Edge TPU.
# webos-ml-library-size-reduction: If the image does not have enough space to install all of the above ML libraries,
# you can reduce the size of the installed library by adding this option. If this option is specified,
# the examples and test codes are excluded from the installation.
WEBOS_DISTRO_FEATURES_AI_FRAMEWORK = "webos-aiframework webos-auto-acceleration webos-edgetpu webos-gpu-delegate"
WEBOS_DISTRO_FEATURES_EXTENDED += "${WEBOS_DISTRO_FEATURES_AI_FRAMEWORK}"

# Addition/removal image features
IMAGE_FEATURES += "${@ 'webos-systemapps webos-testapps webos-extended' if bb.data.inherits_class('webos_image', d) else ''}"

NO_RECOMMENDATIONS = "0"
```

## meta-webos/conf/distro/include/features/webos-features-qtless.inc
```bitbake
# Copyright (c) 2024-2025 LG Electronics, Inc.

require conf/distro/include/features/webos-features-headless.inc

# Increment when features are changed
_pr_suffix .= ".2"

# Addition/removal distro features
WEBOS_DISTRO_FEATURES_QT = ""
```

## meta-webos/conf/distro/include/profile/webos-core-boot.inc
```bitbake
# Copyright (c) 2023-2025 LG Electronics, Inc.

# Define webos core-boot profile features
require conf/distro/include/features/webos-features-core-boot.inc

WEBOS_DISTRO_NAME_SUFFIX = " Core boot"

# Increment when features are changed
IMAGE_PR_SUFFIX = "coreboot1${_pr_suffix}"
```

## meta-webos/conf/distro/include/profile/webos-headless.inc
```bitbake
# Copyright (c) 2024-2025 LG Electronics, Inc.

# Define webos headless profile features
require conf/distro/include/features/webos-features-headless.inc

WEBOS_DISTRO_NAME_SUFFIX = " Headless"

# Increment when features are changed
IMAGE_PR_SUFFIX = "headless1${_pr_suffix}"
```

## meta-webos/conf/distro/include/profile/webos-main.inc
```bitbake
# Copyright (c) 2023-2025 LG Electronics, Inc.

# Define webos main profile features
require conf/distro/include/features/webos-features-main.inc

WEBOS_DISTRO_NAME_SUFFIX = " Main"

# Increment when features are changed
IMAGE_PR_SUFFIX = "main2${_pr_suffix}"
```

## meta-webos/conf/distro/include/profile/webos-minimal.inc
```bitbake
# Copyright (c) 2023-2025 LG Electronics, Inc.

# Define webos minimal profile features
require conf/distro/include/features/webos-features-minimal.inc

WEBOS_DISTRO_NAME_SUFFIX = " Minimal"

# Increment when features are changed
IMAGE_PR_SUFFIX = "minimal3${_pr_suffix}"
```

## meta-webos/conf/distro/include/profile/webos-normal.inc
```bitbake
# Copyright (c) 2023-2025 LG Electronics, Inc.

# Define webos normal profile features
require conf/distro/include/features/webos-features-normal.inc

WEBOS_DISTRO_NAME_SUFFIX = ""

# Increment when features are changed
IMAGE_PR_SUFFIX = "normal1${_pr_suffix}"
```

## meta-webos/conf/distro/include/profile/webos-qtless.inc
```bitbake
# Copyright (c) 2024-2025 LG Electronics, Inc.

# Inherit webos headlesss profile
require conf/distro/include/profile/webos-headless.inc

# Define webos qtless profile features
require conf/distro/include/features/webos-features-qtless.inc

WEBOS_DISTRO_NAME_SUFFIX = " Qt-less"

# Increment when features are changed
IMAGE_PR_SUFFIX = "qtless1${_pr_suffix}"
```

## meta-webos/conf/distro/include/tcmode-default.inc
```bitbake
# Copyright (c) 2014-2025 LG Electronics, Inc.
#
# Things that must be added when using the internal OE toolchain, i.e., when
# TCMODE is "default".
#

require ${COREBASE}/meta/conf/distro/include/tcmode-default.inc

# And this is needed for libgcc and gcc-runtime (which are TUNE_PKGARCH) to be
# built with the same signatures when they depend on by default MACHINE_ARCH
# glibc
PACKAGE_ARCH:pn-glibc = "${TUNE_PKGARCH}"
PACKAGE_ARCH:pn-glibc-initial = "${TUNE_PKGARCH}"
PACKAGE_ARCH:pn-glibc-locale = "${TUNE_PKGARCH}"
PACKAGE_ARCH:pn-glibc-mtrace = "${TUNE_PKGARCH}"
PACKAGE_ARCH:pn-glibc-scripts = "${TUNE_PKGARCH}"
PACKAGE_ARCH:pn-linux-libc-headers = "${TUNE_PKGARCH}"
PACKAGE_ARCH:pn-libgcc-initial = "${TUNE_PKGARCH}"

LIBC_DEPENDENCIES:remove = "libsegfault"

# https://lists.openembedded.org/g/openembedded-core/message/179469
# Allow to independently set P_V for llvm* recipes and actual llvm version used in other places
# This is needed for meta-clang which provides different llvm version from clang recipes, see:
# https://github.com/kraj/meta-clang/pull/766
LLVM_PREFERRED_VERSION ?= "14.0.6"
LLVMVERSION ?= "${LLVM_PREFERRED_VERSION}"

PREFERRED_VERSION_llvm = "${LLVM_PREFERRED_VERSION}"
PREFERRED_VERSION_llvm-native = "${LLVM_PREFERRED_VERSION}"
PREFERRED_VERSION_nativesdk-llvm = "${LLVM_PREFERRED_VERSION}"
```
